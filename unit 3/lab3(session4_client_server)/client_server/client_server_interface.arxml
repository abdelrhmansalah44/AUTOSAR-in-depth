AUTOSAR XML (schema 4-2-2)
package /CLIENT_SERVER_INTERFACE
  client server interface CS_INTERFACE
    operation OPERATION1
      arg IN1: type=uint16, direction=IN
      arg IN2: type=uint16, direction=IN
      arg OUT: type=uint32, direction=OUT
  application sw component type SW1_SUM_require
    require port CLIENT: client-server-annotation=OPERATION1
  application sw component type SW2_SUM_provider
    require port SERVER: client-server-annotation=OPERATION1
