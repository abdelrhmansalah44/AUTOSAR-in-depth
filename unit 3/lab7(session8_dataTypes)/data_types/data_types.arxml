AUTOSAR XML (schema 4-2-2)
package /Data_types_lab
  physical dimension SPEED: length-exp=1
  unit KM_PER_H: factor-si-to-unit=1, physical-dimension=SPEED
  app type speed: category=VALUE, compu {identical; unit KM_PER_H}
  application array data type ARRAY_ELEMENTS: category=ARRAY
    element ARRAY_ELEMENTS: category=VALUE, type=speed, array-size-semantics=FIXED-SIZE, max-number-of-elements=4
  application record data type STRUCT: category=STRUCTURE
    application record element X: category=VALUE, type=speed
    application record element Y: category=VALUE, type=speed
  base type sw_unchar: category=FIXED_LENGTH, base-type-size=8, base-type-encoding=NONE, mem-alignment=1, native-declaration=unsigned char
  base type sw_char: category=FIXED_LENGHT, base-type-size=8, base-type-encoding=2C, mem-alignment=1, native-declaration=char
  impl type abdo_Uchar: category=VALUE, base-type=sw_unchar, range phys 0..255, raw 0..255
  impl type abdo_char: category=VALUE, base-type=sw_char, range phys -128..127, raw -128..127
  data type mapping set MAPPING: data-type-map{application-data-type=speed, implementation-data-type=DC_char}
