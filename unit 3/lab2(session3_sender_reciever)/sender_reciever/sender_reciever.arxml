AUTOSAR XML (schema 4-2-2)
package /Lidar_sender_reciever
  sender receiver interface LIDAR_SR_INTERFACE
    data val1: type=uint8, init-value=5
    data val2: type=uint8, init-value=3
  sensor actuator sw component type LIDAR_SENSOR
    provide port PROVIDE_PORT: provided-interface=LIDAR_SR_INTERFACE
  application sw component type LIDAR_APPLICATION_SW_ALGORITHM
    require port RECIEVING_PORT: required-interface=LIDAR_SR_INTERFACE
